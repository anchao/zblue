## subsys/bluetooth/services/Kconfig
```kconfig
# GATT Services

# Copyright (c) 2018 Nordic Semiconductor ASA
# SPDX-License-Identifier: Apache-2.0

menu "GATT Services"
	depends on BT_CONN

source "$APPSDIR/external/zblue/subsys/bluetooth/services/Kconfig.dis"

source "$APPSDIR/external/zblue/subsys/bluetooth/services/Kconfig.bas"

source "$APPSDIR/external/zblue/subsys/bluetooth/services/Kconfig.hrs"

source "$APPSDIR/external/zblue/subsys/bluetooth/services/ots/Kconfig"

endmenu
```
